## Kconfig
```kconfig
#
# Copyright (c) 2022 Laird Connectivity LLC
#
# SPDX-License-Identifier: LicenseRef-LairdConnectivity-Clause
#
menuconfig LCZ_LWM2M_SW_MANAGEMENT
	bool "LCZ LwM2M Software Management"
	depends on LCZ_LWM2M_CLIENT
	depends on LCZ_LWM2M_SWMGMT_OBJ_SUPPORT

if LCZ_LWM2M_SW_MANAGEMENT

module=LCZ_LWM2M_SW_MANAGEMENT
module-str=LCZ_LWM2M_SW_MANAGEMENT
source "subsys/logging/Kconfig.template.log_config"

config LCZ_LWM2M_SW_MGMT_INIT_PRIORITY
	int "Application init priority"
	range 0 99
	default APPLICATION_INIT_PRIORITY

config LCZ_LWM2M_SW_MGMT_ENABLE_ATTRIBUTES
	bool "Enable attributes"
	depends on ATTR
	help
	  Enable attributes system.

choice
	prompt "Init mode"
	default LCZ_LWM2M_SW_MGMT_INIT_KCONFIG

config LCZ_LWM2M_SW_MGMT_INIT_KCONFIG
	bool "Kconfig"
	help
	  Use Kconfig settings to init.

config LCZ_LWM2M_SW_MGMT_INIT_ATTRIBUTES
	bool "Attributes"
	depends on ATTR
	select LCZ_LWM2M_SW_MGMT_ENABLE_ATTRIBUTES
	help
	  Use attributes system to init.

endchoice

menuconfig LCZ_LWM2M_SW_MGMT_HL7800
	bool "HL7800 modem software management"
	depends on MODEM_HL7800
	depends on MODEM_HL7800_FW_UPDATE
	depends on FILE_SYSTEM_UTILITIES

if LCZ_LWM2M_SW_MGMT_HL7800

config LCZ_LWM2M_SW_MGMT_HL7800_OBJ_INST
	int "Object instace"
	default 0
	help
	  Instance number for object 9

config LCZ_LWM2M_SW_MGMT_HL7800_PKG_NAME
	string "Package name"
	default "HL7800 Firmware"

config LCZ_LWM2M_SW_MGMT_HL7800_FILE_NAME
	string "Download file name"
	default "hl7800_update.bin"
	help
	  Name of the file to save the downloaded firmware update to.

config LCZ_LWM2M_SW_MGMT_HL7800_INSTALL_DELAY_SECONDS
	int "Install delay"
	default 5
	help
	  Delay (in seconds) from the install execute command to when the
	  install begins.

endif # LCZ_LWM2M_SW_MGMT_HL7800

endif # LCZ_LWM2M_SW_MANAGEMENT
```
